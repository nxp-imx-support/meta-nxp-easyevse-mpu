## conf/layer.conf
```bitbake
# We have a conf and classes directory, add to BBPATH
BBPATH .= ":${LAYERDIR}"

# We have recipes-* directories, add to BBFILES
BBFILES += "${LAYERDIR}/recipes-*/*/*.bb \
            ${LAYERDIR}/recipes-*/*/*.bbappend"

BBFILE_COLLECTIONS += "meta-nxp-easyevse"
BBFILE_PATTERN_meta-nxp-easyevse = "^${LAYERDIR}/"
BBFILE_PRIORITY_meta-nxp-easyevse = "8"

LAYERDEPENDS_meta-nxp-easyevse = "fsl-bsp-release imx-demo"
LAYERSERIES_COMPAT_meta-nxp-easyevse = "langdale"
```

## conf/machine/imx8mnevk-easyevse.conf
```bitbake
#@TYPE: Machine
#@NAME: i.MX 93 EVK EasyEVSE
#@DESCRIPTION: i.MX 93 Evaluation Kit EasyEVSE configuration
#@MAINTAINER: Octavian-Tiberiu Sirbu <octavian-tiberiu.sirbu@nxp.com>

require conf/machine/imx8mnevk.conf

# Include device trees for other boards for internal test
KERNEL_DEVICETREE += " \
	freescale/imx8mn-evk-evse.dtb \
	freescale/imx8mn-evk-rm67191-evse.dtb \
	freescale/imx8mn-evk-rm67199-evse.dtb \
"

KERNEL_DEVICETREE_BASENAME = "imx8mn-evk"

UBOOT_CONFIG_BASENAME = "imx8mn_evk_evse"
```

## conf/machine/imx93evk-easyevse.conf
```bitbake
#@TYPE: Machine
#@NAME: i.MX 93 EVK EasyEVSE
#@DESCRIPTION: i.MX 93 Evaluation Kit EasyEVSE configuration
#@MAINTAINER: Octavian-Tiberiu Sirbu <octavian-tiberiu.sirbu@nxp.com>

require conf/machine/imx93evk.conf

# Include device trees for other boards for internal test
KERNEL_DEVICETREE += " \
	freescale/imx93-11x11-evk-evse.dtb \
	freescale/imx93-11x11-evk-rm67199-evse.dtb \
"

KERNEL_DEVICETREE_BASENAME = "imx93-11x11-evk-rm67199-evse"

UBOOT_CONFIG_BASENAME = "imx93_11x11_evk_evse"
```
